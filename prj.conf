## prj.conf
```kconfig
CONFIG_USB_DEVICE_STACK=y
CONFIG_USB_DEVICE_PRODUCT="HID BLE Relay"
CONFIG_USB_DEVICE_PID=0x0003
CONFIG_USB_DEVICE_INITIALIZE_AT_BOOT=n

CONFIG_USB_DEVICE_HID=y
CONFIG_USB_HID_DEVICE_COUNT=2

CONFIG_SERIAL=y
CONFIG_UART_LINE_CTRL=y

CONFIG_PWM=y
CONFIG_GPIO=y

CONFIG_BT=y
CONFIG_BT_PERIPHERAL=y
CONFIG_BT_ZEPHYR_NUS=n

CONFIG_BT_DEVICE_NAME="HID BLE Relay"
```

## src/main.c
```c
/*
 * Copyright (c) 2019 Nordic Semiconductor ASA
 *
 * SPDX-License-Identifier: Apache-2.0
 */
#include <zephyr/kernel.h>
#include <zephyr/device.h>
#include <zephyr/drivers/gpio.h>
#include <zephyr/drivers/pwm.h>
#include <zephyr/drivers/uart.h>
#include <string.h>

#include <zephyr/usb/usb_device.h>
#include <zephyr/usb/class/usb_hid.h>
#include <zephyr/usb/class/usb_cdc.h>

#include "hid_km.h"

#include <zephyr/bluetooth/bluetooth.h>

#include "ble_hidrelay.h"
#include <math.h>

#define DEVICE_NAME		CONFIG_BT_DEVICE_NAME
#define DEVICE_NAME_LEN		(sizeof(DEVICE_NAME) - 1)

#define LED0_NODE DT_ALIAS(led0)
#define LED1_NODE DT_ALIAS(led1)
#define LED2_NODE DT_ALIAS(led2)
#define LED3_NODE DT_ALIAS(led3)

static const struct gpio_dt_spec led0 = GPIO_DT_SPEC_GET(LED0_NODE, gpios);

static const struct pwm_dt_spec red_led = PWM_DT_SPEC_GET(DT_ALIAS(pwm_led0));
static const struct pwm_dt_spec green_led = PWM_DT_SPEC_GET(DT_ALIAS(pwm_led1));
static const struct pwm_dt_spec blue_led = PWM_DT_SPEC_GET(DT_ALIAS(pwm_led2));

// #define HID_REPORT_SIZE 8
#define SW0_NODE DT_ALIAS(sw0)

#if DT_NODE_HAS_STATUS(SW0_NODE, okay)
static const struct gpio_dt_spec sw0_gpio = GPIO_DT_SPEC_GET(SW0_NODE, gpios);
#endif


/* Event FIFO */

K_FIFO_DEFINE(evt_fifo);

enum evt_t {
	GPIO_BUTTON_0	= 0x00,
	LED_SIGNAL_0	= 0x01,
	KEY_UNKNOWN 	= 0x02,
	GPIO_BUTTON_3	= 0x03,
	CDC_UP		= 0x04,
	CDC_DOWN	= 0x05,
	CDC_LEFT	= 0x06,
	CDC_RIGHT	= 0x07,
	CDC_UNKNOWN	= 0x08,
	CDC_STRING	= 0x09,
	HID_MOUSE_CLEAR	= 0x0A,
	HID_KBD_CLEAR	= 0x0B,
	HID_KBD_STRING	= 0x0C,
};

struct app_evt_t {
	sys_snode_t node;
	enum evt_t event_type;
};

#define FIFO_ELEM_MIN_SZ        sizeof(struct app_evt_t)
#define FIFO_ELEM_MAX_SZ        sizeof(struct app_evt_t)
#define FIFO_ELEM_COUNT         255
#define FIFO_ELEM_ALIGN         sizeof(unsigned int)

K_HEAP_DEFINE(event_elem_pool, FIFO_ELEM_MAX_SZ * FIFO_ELEM_COUNT + 256);

static inline void app_evt_free(struct app_evt_t *ev)
{
	k_heap_free(&event_elem_pool, ev);
}

static inline void app_evt_put(struct app_evt_t *ev)
{
	k_fifo_put(&evt_fifo, ev);
}

static inline struct app_evt_t *app_evt_get(void)
{
	return k_fifo_get(&evt_fifo, K_NO_WAIT);
}

static inline void app_evt_flush(void)
{
	struct app_evt_t *ev;

	do {
		ev = app_evt_get();
		if (ev) {
			app_evt_free(ev);
		}
	} while (ev != NULL);
}

static inline struct app_evt_t *app_evt_alloc(void)
{
	struct app_evt_t *ev;

	ev = k_heap_alloc(&event_elem_pool,
			  sizeof(struct app_evt_t),
			  K_NO_WAIT);
	if (ev == NULL) {
		printk("APP event allocation failed!");
		app_evt_flush();

		ev = k_heap_alloc(&event_elem_pool,
				  sizeof(struct app_evt_t),
				  K_NO_WAIT);
		if (ev == NULL) {
			printk("APP event memory corrupted.");
			__ASSERT_NO_MSG(0);
			return NULL;
		}
		return NULL;
	}

	return ev;
}

/* HID */


static K_SEM_DEFINE(evt_sem, 0, 1);	/* starts off "not available" */

static struct gpio_callback gpio_callbacks[4];


uint8_t global_hid_report[HID_REPORT_SIZE_L] = {0};


static const char *gpio0	=	"Button 0 pressed\r\n";
static const char *unknown	=	"Command not recognized.\r\n";
static const char *evt_fail	=	"Unknown event detected!\r\n";
static const char *set_str	=	"String set to: ";
static const char *endl		=	"\r\n";

static bool led_signal = false;
static bool led_error_signal = false;

static void clear_kbd_report(void)
{
	struct app_evt_t *new_evt = app_evt_alloc();

	new_evt->event_type = HID_KBD_CLEAR;
	app_evt_put(new_evt);
	k_sem_give(&evt_sem);
}
/* CDC ACM */

static volatile bool data_transmitted;
static volatile bool data_arrived;

static void write_data(const struct device *dev, const char *buf, int len)
{
	uart_irq_tx_enable(dev);

	while (len) {
		int written;

		data_transmitted = false;
		written = uart_fifo_fill(dev, (const uint8_t *)buf, len);
		while (data_transmitted == false) {
			k_yield();
		}

		len -= written;
		buf += written;
	}

	uart_irq_tx_disable(dev);
}

/* Devices */

static void btn0(const struct device *gpio, struct gpio_callback *cb,
		 uint32_t pins)
{
	struct app_evt_t *ev = app_evt_alloc();

	ev->event_type = GPIO_BUTTON_0,
	app_evt_put(ev);
	k_sem_give(&evt_sem);
}

int callbacks_configure(const struct gpio_dt_spec *gpio,
			void (*handler)(const struct device *, struct gpio_callback*,
					uint32_t),
			struct gpio_callback *callback)
{
	if (!device_is_ready(gpio->port)) {
		printk("%s: device not ready.", gpio->port->name);
		return -ENODEV;
	}

	gpio_pin_configure_dt(gpio, GPIO_INPUT);

	gpio_init_callback(callback, handler, BIT(gpio->pin));
	gpio_add_callback(gpio->port, callback);
	gpio_pin_interrupt_configure_dt(gpio, GPIO_INT_EDGE_TO_ACTIVE);

	return 0;
}

static void status_cb(enum usb_dc_status_code status, const uint8_t *param)
{
	printk("Status %d", status);
}

static const struct bt_data ad[] = {
	BT_DATA_BYTES(BT_DATA_FLAGS, (BT_LE_AD_GENERAL | BT_LE_AD_NO_BREDR)),
	BT_DATA(BT_DATA_NAME_COMPLETE, DEVICE_NAME, DEVICE_NAME_LEN),
};

static const struct bt_data sd[] = {
	BT_DATA_BYTES(BT_DATA_UUID128_ALL, BT_UUID_HIDRELAY_SVC_VAL),
};

static bool bt_disconnected = true;

static void notif_enabled(bool enabled, void *ctx)
{
	ARG_UNUSED(ctx);

	printk("%s() - %s\n", __func__, (enabled ? "Enabled" : "Disabled"));

	if(enabled){
		bt_disconnected = false;

	}
	else{
		bt_disconnected = true;
		
	}
}
static uint8_t pressed_keys[6] = {0};
static uint8_t current_modifiers = 0;

static void add_key(uint8_t key)
{
    for (int i = 0; i < 6; i++) {
        if (pressed_keys[i] == 0) {
            pressed_keys[i] = key;
            return;
        }
    }
}

/* pressed_keys 배열에서 key 제거 */
static void remove_key(uint8_t key)
{
    for (int i = 0; i < 6; i++) {
        if (pressed_keys[i] == key) {
            pressed_keys[i] = 0;
        }
    }
    
	return;
}

/* 전체 상태(Modifiers + pressed_keys[])를 바탕으로 HID 리포트 전송 */
static void send_full_report(void)
{
    uint8_t rep[8] = {0};

    /* rep[0] : Modifier 비트마스크 */
    rep[0] = current_modifiers;

    /* rep[1] : Reserved(항상 0) */
    rep[1] = 0;

    /* rep[2..7] : 동시에 눌려있는 일반 키(최대 6개) */
    for (int i = 0; i < 6; i++) {
        rep[i + 2] = pressed_keys[i];
    }

    if (hid_keyboard_send_report(rep)) {
        printk("Failed to send HID report\n");
    }
}

/* modifier 키 비트마스크를 업데이트해주는 함수 */
void update_modifiers(uint8_t modifier_mask, bool press)
{
    if (press) {
        current_modifiers |= modifier_mask;
    } else {
        current_modifiers &= ~modifier_mask;
    }
	// printk("Current Modifiers: 0x%02x \n", current_modifiers);
}
static uint32_t x_pos = 0;
static uint32_t y_pos = 0;	

static void received(struct bt_conn *conn, const void *data, uint16_t len, void *ctx)
{
	char message[CONFIG_BT_L2CAP_TX_MTU + 1] = "";
	
	ARG_UNUSED(conn);
	ARG_UNUSED(ctx);

    size_t copy_len = len < sizeof(message) - 1 ? len : sizeof(message) - 1;
    memcpy(message, data, copy_len);
    message[copy_len] = '\0'; // Null-terminate the string

 	char *token = strtok(message, "\n");
    while (token != NULL) {
		/* Wire format: <device><action>:<payload> — minimum 4 bytes
		 * (e.g. "MM:0"). Reject anything shorter to keep the payload
		 * pointer below from running past the buffer. */
		size_t tlen = strlen(token);
		if (tlen < 4 || token[2] != ':') {
			led_error_signal = true;
			printk("Malformed token: '%s'\n", token);
			token = strtok(NULL, "\n");
			continue;
		}

		char device = token[0];
		char action = token[1];
		char *payload = token + 3;
		uint32_t qt_key;

		if (device == 'K') {
			if (sscanf(payload, "0x%x", &qt_key) == 1) {
				bool is_press = (action == 'P');
				uint8_t hid_key = 0;
				uint8_t modifier_mask = 0;

				if (get_hid_key(qt_key, &hid_key, &modifier_mask)) {
					if (modifier_mask != 0) {
						update_modifiers(modifier_mask, is_press);
						if (hid_key != 0) {
							if (is_press) {
								add_key(hid_key);
							} else {
								remove_key(hid_key);
							}
						}
					} else {
						if (is_press) {
							add_key(hid_key);
						} else {
							remove_key(hid_key);
						}
					}
					led_signal = true;
					send_full_report();
				} else if (!is_press) {
					printk("Key not found: %c:0x%x\n", action, qt_key);
					struct app_evt_t *ev = app_evt_alloc();
					led_error_signal = true;
					ev->event_type = KEY_UNKNOWN;
					app_evt_put(ev);
					k_sem_give(&evt_sem);
				}
			}
		} else if (device == 'M') {
			if (sscanf(payload, "%u,%u", &x_pos, &y_pos) == 2) {
				int button = -1;
				switch (action) {
				case 'L': button = 1; break;        /* left press / drag */
				case 'R': button = 2; break;        /* right press / drag */
				case 'M': button = 0; break;        /* move, no button held */
				case 'S':                           /* left release */
				case 'E': button = 0; break;        /* right release */
				}
				if (button >= 0) {
					led_signal = true;
					hid_mouse_abs_send((uint8_t)button, x_pos, y_pos, 0);
				}
			}
		} else if (device == 'W' && action == 'W') {
			int wheel = 0;
			if (sscanf(payload, "%d", &wheel) == 1) {
				if (wheel > 127)  wheel = 127;
				if (wheel < -127) wheel = -127;
				led_signal = true;
				hid_mouse_abs_send(0, x_pos, y_pos, (int8_t)wheel);
			}
		} else {
			led_error_signal = true;
			printk("Command not recognized: %s\n", token);
			struct app_evt_t *ev = app_evt_alloc();
			ev->event_type = CDC_UNKNOWN;
			app_evt_put(ev);
			k_sem_give(&evt_sem);
		}

        token = strtok(NULL, "\n");
	}

}

static struct bt_hidrelay_cb hidrelay_cb = {
	.notif_enabled = notif_enabled,
	.received      = received,
};

#define DEVICE_AND_COMMA(node_id) DEVICE_DT_GET(node_id),

int main(void)
{	
	if (!gpio_is_ready_dt(&led0)) {
		return 0;
	}
	gpio_pin_configure_dt(&led0, GPIO_OUTPUT_INACTIVE);

	gpio_pin_set_dt(&led0, 1);
	k_msleep(50);
	gpio_pin_set_dt(&led0, 0);
	k_msleep(50);

	if (!device_is_ready(blue_led.dev) || !device_is_ready(green_led.dev) || !device_is_ready(red_led.dev))
	{
		printk("Error: PWM device not ready.\n");
		return 0;
	}

	const struct device *cdc_dev = DEVICE_DT_GET_ONE(zephyr_cdc_acm_uart);

	struct app_evt_t *ev;
	int ret;

	hid_keyboard_init();

	/* Config BT */
	int err;
	err = bt_enable(NULL);
	if (err) {
		printk("Failed to enable bluetooth: %d\n", err);
		return err;
	}

	err = bt_hidrelay_init(&hidrelay_cb, NULL);
	if (err) {
		printk("Failed to register HIDRelay cb (err %d)\n", err);
		return err;
	}
	printk("HIDRelay service registered\n");


	err = bt_le_adv_start(BT_LE_ADV_CONN, ad, ARRAY_SIZE(ad), sd, ARRAY_SIZE(sd));
	if (err) {
		printk("Advertising failed to start (err %d)\n", err);
		return 0;
	}
	printk("Advertising started with HIDRelay UUID\n");


	if (!device_is_ready(cdc_dev)) {
		printk("CDC ACM device %s is not ready",
			cdc_dev->name);
		return 0;
	}


	if (callbacks_configure(&sw0_gpio, &btn0, &gpio_callbacks[0])) {
		printk("Failed configuring button 0 callback.");
		return 0;
	}
	

	ret = usb_enable(status_cb);
	if (ret != 0) {
		printk("Failed to enable USB");
		return 0;
	}

	int cnt = 0;
	uint32_t b_fade = 0;

	// int led_blink = 0;
	int led_blink_cnt = 0;
	int led_err_blink_cnt = 0;

	const int led_blink_interval = 30;

	while (true) {
		if (cnt++ == 1000)
		{
			cnt = 0;
		}
		int32_t fade = blue_led.period * sin((double)cnt / 1000.0 * 3.14);
		uint32_t ufade = fade < 0 ? -fade : fade;

		k_msleep(1);
		if(bt_disconnected)
		{
			if (b_fade != ufade)
			{
				b_fade = ufade;
				ret = pwm_set_dt(&blue_led, blue_led.period, ufade);

				if (ret < 0)
				{
					printk("Error: Failed to set PWM value.\n");
					return 0;
				}
			}
		}
		else //connected
		{
			if (b_fade != blue_led.period)
			{
				b_fade = blue_led.period;
				ret = pwm_set_dt(&blue_led, blue_led.period, blue_led.period);

				if (ret < 0)
				{
					printk("Error: Failed to set PWM value.\n");
					return 0;
				}
			}
		}
		// ret = pwm_set_dt(&blue_led, blue_led.period, ufade);

		if (ret < 0)
		{
			printk("Error: Failed to set PWM value.\n");
			return 0;
		}
		if (led_error_signal && led_err_blink_cnt == 0)
		{
			led_error_signal = false;
			led_err_blink_cnt = led_blink_interval * 2;
		}

		if (led_signal && led_blink_cnt == 0)
		{
			led_signal = false;
			led_blink_cnt = led_blink_interval * 2;
		}

		if(led_err_blink_cnt > 0)
		{
			if (led_err_blink_cnt-- < led_blink_interval)
			{
				pwm_set_dt(&red_led, red_led.period, 0);
			}
			else
			{
				pwm_set_dt(&red_led, red_led.period, red_led.period);
			}
		}

		if(led_blink_cnt > 0)
		{
			if (led_blink_cnt-- < led_blink_interval)
			{
				gpio_pin_set_dt(&led0, 0);
			}
			else
			{
				gpio_pin_set_dt(&led0, 1);
			}
		}

		while ((ev = app_evt_get()) != NULL) {
			switch (ev->event_type) {
			case GPIO_BUTTON_0:
			{
								/* RESET key */
				uint8_t rep[] = {0x00, 0x00, 0x00, 0x00,
					      0x00, 0x00, 0x00,
					      0x00};

				hid_keyboard_send_report(rep);
				// hid_int_ep_write(hid0_dev, rep,
				// 		 sizeof(rep), NULL);
				write_data(cdc_dev, gpio0, strlen(gpio0));
				clear_kbd_report();
				break;
			}
			case LED_SIGNAL_0:
			{
				gpio_pin_set_dt(&led0, 1);
				k_msleep(50);
				gpio_pin_set_dt(&led0, 0);
				k_msleep(50);
				/* LED Signal 0 */

				break;
			}
			case KEY_UNKNOWN:
			{
				printk("Unknown key event!\n");
				uint8_t rep[8] = {0};
				uint8_t rep2[8] = {0};
				uint8_t crep[] = {0x00, 0x00, 0x00, 0x00,
					      0x00, 0x00, 0x00, 0x00};
				rep[2] = HID_KEY_E;
				rep[3] = HID_KEY_R;

				rep2[2] = HID_KEY_R;
				rep2[3] = HID_KEY_O;
				rep2[4] = HID_KEY_R;

				hid_keyboard_send_report(rep);
				hid_keyboard_send_report(crep);
				hid_keyboard_send_report(rep2);
				hid_keyboard_send_report(crep);
				break;
			}
			case CDC_UNKNOWN:
			{
				write_data(cdc_dev, unknown, strlen(unknown));
				break;
			}
			case CDC_STRING:
			{
				write_data(cdc_dev, set_str, strlen(set_str));
				// write_data(cdc_dev, string, strlen(string));
				write_data(cdc_dev, endl, strlen(endl));

				break;
			}
			case HID_KBD_CLEAR:
			{
				/* Clear kbd report */
				uint8_t rep[] = {0x00, 0x00, 0x00, 0x00,
					      0x00, 0x00, 0x00, 0x00};

				hid_keyboard_send_report(rep);
				break;
			}
			default:
			{
				printk("Unknown event to execute");
				write_data(cdc_dev, evt_fail,
					   strlen(evt_fail));
				break;
			}
			break;
			}
			app_evt_free(ev);
		}
	}
}
```

## src/ble_hidrelay.c
```c
/*
 *
 * HID Relay Custom BLE Service (Static GATT)
 */

#include <zephyr/kernel.h>
#include <zephyr/logging/log.h>
LOG_MODULE_REGISTER(hidrelay, LOG_LEVEL_INF);

#include <zephyr/bluetooth/gatt.h>
#include <zephyr/bluetooth/conn.h>
#include "ble_hidrelay.h"

static const struct bt_hidrelay_cb *g_cb;
static void *g_user_data;

/* -----------------------------------------------------------------------------
 * RX (Write) handler
 * -----------------------------------------------------------------------------
 */
static ssize_t hidrelay_rx_write(struct bt_conn *conn,
				 const struct bt_gatt_attr *attr,
				 const void *buf,
				 uint16_t len,
				 uint16_t offset,
				 uint8_t flags)
{
	LOG_DBG("hidrelay_rx_write: len=%u", len);

	if (g_cb && g_cb->received) {
		g_cb->received(conn, buf, len, g_user_data);
	}
	return len;
}

/* -----------------------------------------------------------------------------
 * Change CCC Descriptor (Notify On/Off)
 * -----------------------------------------------------------------------------
 */
static void hidrelay_ccc_cfg_changed(const struct bt_gatt_attr *attr, uint16_t value)
{
	bool enabled = (value == BT_GATT_CCC_NOTIFY);

	LOG_DBG("hidrelay_ccc_cfg_changed: %s", (enabled ? "Notify On" : "Notify Off"));

	if (g_cb && g_cb->notif_enabled) {
		g_cb->notif_enabled(enabled, g_user_data);
	}
}

/* -----------------------------------------------------------------------------
 * GATT Table Definition
 *
 * 0: Service Declaration
 * 1: RX Char Declaration
 * 2: RX Char Value
 * 3: TX Char Declaration
 * 4: TX Char Value
 * 5: CCC Descriptor
 * -----------------------------------------------------------------------------
 */
BT_GATT_SERVICE_DEFINE(hidrelay_svc,
	/* Service */
	BT_GATT_PRIMARY_SERVICE(BT_UUID_HIDRELAY_SERVICE),

	/* RX Characteristic */
	BT_GATT_CHARACTERISTIC(
		BT_UUID_HIDRELAY_RX_CHAR,
		BT_GATT_CHRC_WRITE | BT_GATT_CHRC_WRITE_WITHOUT_RESP,
		BT_GATT_PERM_WRITE,
		NULL,                /* read callback */
		hidrelay_rx_write,   /* write callback */
		NULL                 /* value */
	),

	/* TX Characteristic */
	BT_GATT_CHARACTERISTIC(
		BT_UUID_HIDRELAY_TX_CHAR,
		BT_GATT_CHRC_NOTIFY | BT_GATT_CHRC_READ,
		BT_GATT_PERM_READ,
		NULL,                /* read callback */
		NULL,                /* write callback */
		NULL                 /* value */
	),

	/* CCC Descriptor for TX */
	BT_GATT_CCC(hidrelay_ccc_cfg_changed,
		BT_GATT_PERM_READ | BT_GATT_PERM_WRITE)
);

/* -----------------------------------------------------------------------------
 * API: HIDRelay Service Initialization
 * -----------------------------------------------------------------------------
 */
int bt_hidrelay_init(const struct bt_hidrelay_cb *cb, void *user_data)
{
	if (!cb) {
		return -EINVAL;
	}

	g_cb = cb;
	g_user_data = user_data;

	LOG_INF("HIDRelay service (static GATT) initialized");
	return 0;
}

int bt_hidrelay_send(struct bt_conn *conn, const void *data, uint16_t len)
{
	if (!data || !len) {
		return -EINVAL;
	}

	return bt_gatt_notify(conn, &hidrelay_svc.attrs[4], data, len);
}
```

## src/ble_hidrelay.h
```c
/*
 * HID Relay Custom BLE Service (Static GATT)
 */

#ifndef ZEPHYR_INCLUDE_BLUETOOTH_SERVICES_HIDRELAY_H_
#define ZEPHYR_INCLUDE_BLUETOOTH_SERVICES_HIDRELAY_H_

#include <zephyr/bluetooth/conn.h>
#include <zephyr/bluetooth/gatt.h>
#include <zephyr/bluetooth/uuid.h> /* BT_UUID_128_ENCODE, etc. */

#ifdef __cplusplus
extern "C" {
#endif

/*------------------------------------------------------------------------------
 * 1) UUID 
 *
 * Service: 597f1290-5b99-477d-9261-f0ed801fc566
 * RX Char: 597f1291-5b99-477d-9261-f0ed801fc566
 * TX Char: 597f1292-5b99-477d-9261-f0ed801fc566
 *------------------------------------------------------------------------------
 */

#define BT_UUID_HIDRELAY_SVC_VAL \
	BT_UUID_128_ENCODE(0x597f1290, 0x5b99, 0x477d, 0x9261, 0xf0ed801fc566)

#define BT_UUID_HIDRELAY_RX_VAL \
	BT_UUID_128_ENCODE(0x597f1291, 0x5b99, 0x477d, 0x9261, 0xf0ed801fc566)

#define BT_UUID_HIDRELAY_TX_VAL \
	BT_UUID_128_ENCODE(0x597f1292, 0x5b99, 0x477d, 0x9261, 0xf0ed801fc566)

#define BT_UUID_HIDRELAY_SERVICE BT_UUID_DECLARE_128(BT_UUID_HIDRELAY_SVC_VAL)
#define BT_UUID_HIDRELAY_RX_CHAR BT_UUID_DECLARE_128(BT_UUID_HIDRELAY_RX_VAL)
#define BT_UUID_HIDRELAY_TX_CHAR BT_UUID_DECLARE_128(BT_UUID_HIDRELAY_TX_VAL)

/*------------------------------------------------------------------------------
 * 2) Callbacks
 *------------------------------------------------------------------------------
 */

struct bt_hidrelay_cb {
	/** @brief TX Notify : Change Subscription (Notify On/Off) */
	void (*notif_enabled)(bool enabled, void *user_data);

	/** @brief RX Write Event (Central -> Peripheral) */
	void (*received)(struct bt_conn *conn, const void *data, uint16_t len,
			 void *user_data);
};

/*------------------------------------------------------------------------------
 * 3) API Functions
 *------------------------------------------------------------------------------
 */

/**
 * @brief HIDRelay Service Initialization
 *
 *
 * @param cb        callback functions
 * @param user_data user data
 *
 * @return 0 on success, negative on error
 */
int bt_hidrelay_init(const struct bt_hidrelay_cb *cb, void *user_data);

/**
 * @brief HIDRelay TX Notify transmit
 *
 * @param conn   Target Connection Handle
 * @param data   
 * @param len    
 *
 * @return 0 on success, negative error
 */
int bt_hidrelay_send(struct bt_conn *conn, const void *data, uint16_t len);

#ifdef __cplusplus
}
#endif

#endif /* ZEPHYR_INCLUDE_BLUETOOTH_SERVICES_HIDRELAY_H_ */
```

## src/hid_keyboard.h
```c
#ifndef HID_KEYBOARD_H
#define HID_KEYBOARD_H
#include <stdint.h>
#include <stdbool.h>
#include <stdio.h>

#define HID_REPORT_SIZE_L 8
#define HID_REPORT_SIZE_M 4


bool hid_keyboard_init(void);

bool hid_keyboard_send_report(uint8_t *report);
bool get_hid_key(uint32_t qt_key, uint8_t *hid_key, uint8_t *modifier);

bool hid_mouse_abs_send(uint8_t buttons, uint16_t x, uint16_t y);
bool hid_mouse_abs_clear(void);
// bool hid_touch_send_report(uint8_t contact_count, uint16_t x_pos, uint16_t y_pos, uint8_t contact_id);
// bool hid_touch_clear_report(void);
// void update_modifiers(uint8_t modifier, bool press, uint8_t *cmodifier);
#endif // HID_KEYBOARD_H
```

## src/hid_km.c
```c
#include "hid_km.h"
#include "usb_hid_keys.h"

#include <zephyr/kernel.h>
#include <zephyr/device.h>
#include <zephyr/drivers/gpio.h>
#include <zephyr/drivers/uart.h>

#include <zephyr/usb/usb_device.h>
#include <zephyr/usb/class/usb_hid.h>

#include <string.h>

typedef struct {
    uint32_t qt_key;
    uint8_t hid_key;
    uint8_t modifier;
} qt_to_hid_mapping_t;

#define HID_REPORT_SIZE_M 6
#define HID_REPORT_SIZE_T 7
#define HID_REPORT_SIZE_K 8

#define HID_MOD_LCTRL  KEY_MOD_LCTRL
#define HID_MOD_LSHIFT KEY_MOD_LSHIFT
#define HID_MOD_LALT   KEY_MOD_LALT
#define HID_MOD_LMETA  KEY_MOD_LMETA
#define HID_MOD_RCTRL  KEY_MOD_RCTRL
#define HID_MOD_RSHIFT KEY_MOD_RSHIFT
#define HID_MOD_RALT   KEY_MOD_RALT
#define HID_MOD_RMETA  KEY_MOD_RMETA
#define DataVarAbs 0x02


static const uint8_t hid_mouse_abs_report_desc[]={
    0x05, 0x01,        /* Usage Page (Generic Desktop) */
    0x09, 0x02,        /* Usage (Mouse) */
    0xa1, 0x01,        /* Collection (Application) */
      0x09, 0x01,      /*   Usage (Pointer) */
      0xa1, 0x00,      /*   Collection (Physical) */

        /* 3개 버튼 (Left, Right, Middle) */
        0x05, 0x09,    /*     Usage Page (Button) */
        0x19, 0x01,    /*     Usage Minimum (Button 1) */
        0x29, 0x03,    /*     Usage Maximum (Button 3) */
        0x15, 0x00,    /*     Logical Minimum (0) */
        0x25, 0x01,    /*     Logical Maximum (1) */
        0x95, 0x03,    /*     Report Count (3 buttons) */
        0x75, 0x01,    /*     Report Size (1 bit) */
        0x81, 0x02,    /*     Input (Data,Var,Abs) */

        /* 버튼 외 나머지 5bit 패딩 */
        0x95, 0x01,    
        0x75, 0x05,
        0x81, 0x03,    /*     Input (Cnst,Var,Abs) */

        /* X Absolute */
        0x05, 0x01,    /*     Usage Page (Generic Desktop) */
        0x09, 0x30,    /*     Usage (X) */
        0x15, 0x00,    /*     Logical Min (0) */
        0x26, 0xFF, 0x7F, /*  Logical Max (32767) */
        0x75, 0x10,    /*     Report Size (16 bits) */
        0x95, 0x01,    /*     Report Count (1) */
        0x81, 0x02,    /*     Input (Data,Var,Abs) */

        /* Y Absolute */
        0x09, 0x31,    /*     Usage (Y) */
        0x15, 0x00,    /*     Logical Min (0) */
        0x26, 0xFF, 0x7F, /*  Logical Max (32767) */
        0x75, 0x10,    /*     Report Size (16 bits) */
        0x95, 0x01,    /*     Report Count (1) */
        0x81, 0x02,    /*     Input (Data,Var,Abs) */
        
        // Wheel
        0x09, 0x38,    //   Usage (Wheel)
        0x15, 0x81,    //   Logical Minimum (-127)
        0x25, 0x7F,    //   Logical Maximum (127)
        0x75, 0x08,    //   Report Size (8 bit)
        0x95, 0x01,    //   Report Count (1)
        0x81, 0x06,    //   Input (Data,Var,Rel)

      0xc0,           /*   End Collection (Physical) */
    0xc0              /* End Collection (Application) */
};



const qt_to_hid_mapping_t qt_hid_map[] = {
    // ----------------------------
    // Regular Keys and Symbols
    // ----------------------------
    
    // Space
    {0x20, KEY_SPACE, 0}, // Qt::Key_Space

    // Symbols with Shift modifiers
    {0x21, KEY_1, HID_MOD_LSHIFT}, // Qt::Key_Exclam '!'
    {0x22, KEY_APOSTROPHE, HID_MOD_LSHIFT}, // Qt::Key_QuoteDbl '"'
    {0x23, KEY_3, HID_MOD_LSHIFT}, // Qt::Key_NumberSign '#'
    {0x24, KEY_4, HID_MOD_LSHIFT}, // Qt::Key_Dollar '$'
    {0x25, KEY_5, HID_MOD_LSHIFT}, // Qt::Key_Percent '%'
    {0x26, KEY_7, HID_MOD_LSHIFT}, // Qt::Key_Ampersand '&'
    {0x27, KEY_APOSTROPHE, 0}, // Qt::Key_Apostrophe '''
    {0x28, KEY_9, HID_MOD_LSHIFT}, // Qt::Key_ParenLeft '('
    {0x29, KEY_0, HID_MOD_LSHIFT}, // Qt::Key_ParenRight ')'
    {0x2a, KEY_KPASTERISK, 0}, // Qt::Key_Asterisk '*'
    {0x2b, KEY_EQUAL, HID_MOD_LSHIFT}, // Qt::Key_Plus '+'
    {0x2c, KEY_COMMA, 0}, // Qt::Key_Comma ','
    {0x2d, KEY_MINUS, 0}, // Qt::Key_Minus '-'
    {0x2e, KEY_DOT, 0}, // Qt::Key_Period '.'
    {0x2f, KEY_SLASH, 0}, // Qt::Key_Slash '/'

    // Numbers
    {0x30, KEY_0, 0}, // Qt::Key_0 '0'
    {0x31, KEY_1, 0}, // Qt::Key_1 '1'
    {0x32, KEY_2, 0}, // Qt::Key_2 '2'
    {0x33, KEY_3, 0}, // Qt::Key_3 '3'
    {0x34, KEY_4, 0}, // Qt::Key_4 '4'
    {0x35, KEY_5, 0}, // Qt::Key_5 '5'
    {0x36, KEY_6, 0}, // Qt::Key_6 '6'
    {0x37, KEY_7, 0}, // Qt::Key_7 '7'
    {0x38, KEY_8, 0}, // Qt::Key_8 '8'
    {0x39, KEY_9, 0}, // Qt::Key_9 '9'

    // More Symbols
    {0x3a, KEY_SEMICOLON, HID_MOD_LSHIFT}, // Qt::Key_Colon ':'
    {0x3b, KEY_SEMICOLON, 0}, // Qt::Key_Semicolon ';'
    {0x3c, KEY_COMMA, HID_MOD_LSHIFT}, // Qt::Key_Less '<'
    {0x3d, KEY_EQUAL, 0}, // Qt::Key_Equal '='
    {0x3e, KEY_DOT, HID_MOD_LSHIFT}, // Qt::Key_Greater '>'
    {0x3f, KEY_SLASH, HID_MOD_LSHIFT}, // Qt::Key_Question '?'
    {0x40, KEY_2, HID_MOD_LSHIFT}, // Qt::Key_At '@'
    // Letters
    {0x41, KEY_A, 0}, // Qt::Key_A 'A'
    {0x42, KEY_B, 0}, // Qt::Key_B 'B'
    {0x43, KEY_C, 0}, // Qt::Key_C 'C'
    {0x44, KEY_D, 0}, // Qt::Key_D 'D'
    {0x45, KEY_E, 0}, // Qt::Key_E 'E'
    {0x46, KEY_F, 0}, // Qt::Key_F 'F'
    {0x47, KEY_G, 0}, // Qt::Key_G 'G'
    {0x48, KEY_H, 0}, // Qt::Key_H 'H'
    {0x49, KEY_I, 0}, // Qt::Key_I 'I'
    {0x4a, KEY_J, 0}, // Qt::Key_J 'J'
    {0x4b, KEY_K, 0}, // Qt::Key_K 'K'
    {0x4c, KEY_L, 0}, // Qt::Key_L 'L'
    {0x4d, KEY_M, 0}, // Qt::Key_M 'M'
    {0x4e, KEY_N, 0}, // Qt::Key_N 'N'
    {0x4f, KEY_O, 0}, // Qt::Key_O 'O'
    {0x50, KEY_P, 0}, // Qt::Key_P 'P'
    {0x51, KEY_Q, 0}, // Qt::Key_Q 'Q'
    {0x52, KEY_R, 0}, // Qt::Key_R 'R'
    {0x53, KEY_S, 0}, // Qt::Key_S 'S'
    {0x54, KEY_T, 0}, // Qt::Key_T 'T'
    {0x55, KEY_U, 0}, // Qt::Key_U 'U'
    {0x56, KEY_V, 0}, // Qt::Key_V 'V'
    {0x57, KEY_W, 0}, // Qt::Key_W 'W'
    {0x58, KEY_X, 0}, // Qt::Key_X 'X'
    {0x59, KEY_Y, 0}, // Qt::Key_Y 'Y'
    {0x5a, KEY_Z, 0}, // Qt::Key_Z 'Z'

    // Additional Symbols
    {0x5b, KEY_LEFTBRACE, 0}, // Qt::Key_BracketLeft '['
    {0x5c, KEY_BACKSLASH, 0}, // Qt::Key_Backslash '\'
    {0x5d, KEY_RIGHTBRACE, 0}, // Qt::Key_BracketRight ']'
    {0x5e, KEY_GRAVE, HID_MOD_LSHIFT}, // Qt::Key_AsciiCircum '^'
    {0x5f, KEY_MINUS, HID_MOD_LSHIFT}, // Qt::Key_Underscore '_'
    {0x60, KEY_GRAVE, 0}, // Qt::Key_QuoteLeft '`'

    {0x7b, KEY_LEFTBRACE, HID_MOD_LSHIFT}, // Qt::Key_BraceLeft '{'
    {0x7c, KEY_BACKSLASH, HID_MOD_LSHIFT}, // Qt::Key_Bar '|'
    {0x7d, KEY_RIGHTBRACE, HID_MOD_LSHIFT}, // Qt::Key_BraceRight '}'
    {0x7e, KEY_GRAVE, HID_MOD_LSHIFT}, // Qt::Key_AsciiTilde '~'

    // ----------------------------
    // Function Keys
    // ----------------------------
    {0x01000030, KEY_F1, 0}, // Qt::Key_F1
    {0x01000031, KEY_F2, 0}, // Qt::Key_F2
    {0x01000032, KEY_F3, 0}, // Qt::Key_F3
    {0x01000033, KEY_F4, 0}, // Qt::Key_F4
    {0x01000034, KEY_F5, 0}, // Qt::Key_F5
    {0x01000035, KEY_F6, 0}, // Qt::Key_F6
    {0x01000036, KEY_F7, 0}, // Qt::Key_F7
    {0x01000037, KEY_F8, 0}, // Qt::Key_F8
    {0x01000038, KEY_F9, 0}, // Qt::Key_F9
    {0x01000039, KEY_F10, 0}, // Qt::Key_F10
    {0x0100003a, KEY_F11, 0}, // Qt::Key_F11
    {0x0100003b, KEY_F12, 0}, // Qt::Key_F12
    {0x0100003c, KEY_F13, 0}, // Qt::Key_F13
    {0x0100003d, KEY_F14, 0}, // Qt::Key_F14
    {0x0100003e, KEY_F15, 0}, // Qt::Key_F15
    {0x0100003f, KEY_F16, 0}, // Qt::Key_F16
    {0x01000040, KEY_F17, 0}, // Qt::Key_F17
    {0x01000041, KEY_F18, 0}, // Qt::Key_F18
    {0x01000042, KEY_F19, 0}, // Qt::Key_F19
    {0x01000043, KEY_F20, 0}, // Qt::Key_F20
    {0x01000044, KEY_F21, 0}, // Qt::Key_F21
    {0x01000045, KEY_F22, 0}, // Qt::Key_F22
    {0x01000046, KEY_F23, 0}, // Qt::Key_F23
    {0x01000047, KEY_F24, 0}, // Qt::Key_F24
    {0x01000048, KEY_NONE, 0}, // Qt::Key_F25
    {0x01000049, KEY_NONE, 0}, // Qt::Key_F26
    {0x0100004a, KEY_NONE, 0}, // Qt::Key_F27
    {0x0100004b, KEY_NONE, 0}, // Qt::Key_F28
    {0x0100004c, KEY_NONE, 0}, // Qt::Key_F29
    {0x0100004d, KEY_NONE, 0}, // Qt::Key_F30
    {0x0100004e, KEY_NONE, 0}, // Qt::Key_F31
    {0x0100004f, KEY_NONE, 0}, // Qt::Key_F32
    {0x01000050, KEY_NONE, 0}, // Qt::Key_F33
    {0x01000051, KEY_NONE, 0}, // Qt::Key_F34
    {0x01000052, KEY_NONE, 0}, // Qt::Key_F35

    // ----------------------------
    // Modifier Keys
    // ----------------------------
    {0x01000020, KEY_LEFTSHIFT, HID_MOD_LSHIFT}, // Qt::Key_Shift
    {0x01000021, KEY_LEFTCTRL, HID_MOD_LCTRL},   // Qt::Key_Control
    {0x01000022, KEY_LEFTMETA, HID_MOD_LMETA},   // Qt::Key_Meta
    {0x01000023, KEY_LEFTALT, HID_MOD_LALT},     // Qt::Key_Alt
    {0x01001103, KEY_RIGHTALT, HID_MOD_RALT},    // Qt::Key_AltGr

    // ----------------------------
    // Lock Keys
    // ----------------------------
    {0x01000024, KEY_CAPSLOCK, 0}, // Qt::Key_CapsLock
    {0x01000025, KEY_NUMLOCK, 0}, // Qt::Key_NumLock
    {0x01000026, KEY_SCROLLLOCK, 0}, // Qt::Key_ScrollLock

    // ----------------------------
    // Special Keys
    // ----------------------------
    {0x01000000, KEY_ESC, 0}, // Qt::Key_Escape
    {0x01000001, KEY_TAB, 0}, // Qt::Key_Tab
    {0x01000002, KEY_BACKSPACE, 0}, // Qt::Key_Backtab
    {0x01000003, KEY_BACKSPACE, 0}, // Qt::Key_Backspace
    {0x01000004, KEY_ENTER, 0}, // Qt::Key_Return
    {0x01000005, KEY_KPENTER, 0}, // Qt::Key_Enter
    {0x01000006, KEY_INSERT, 0}, // Qt::Key_Insert
    {0x01000007, KEY_DELETE, 0}, // Qt::Key_Delete
    {0x01000008, KEY_PAUSE, 0}, // Qt::Key_Pause
    {0x01000009, KEY_SYSRQ, 0}, // Qt::Key_Print
    {0x0100000a, KEY_SYSRQ, 0}, // Qt::Key_SysReq
    // {0x0100000b, KEY_CLEAR, 0}, // Qt::Key_Clear

    {0x01000010, KEY_HOME, 0}, // Qt::Key_Home
    {0x01000011, KEY_END, 0}, // Qt::Key_End
    {0x01000012, KEY_LEFT, 0}, // Qt::Key_Left
    {0x01000013, KEY_UP, 0}, // Qt::Key_Up
    {0x01000014, KEY_RIGHT, 0}, // Qt::Key_Right
    {0x01000015, KEY_DOWN, 0}, // Qt::Key_Down
    {0x01000016, KEY_PAGEUP, 0}, // Qt::Key_PageUp
    {0x01000017, KEY_PAGEDOWN, 0}, // Qt::Key_PageDown

    {0x01000053, KEY_FRONT, 0}, // Qt::Key_Super_L
    {0x01000054, KEY_FRONT, 0}, // Qt::Key_Super_R
    {0x01000055, KEY_PROPS, 0}, // Qt::Key_Menu
    {0x01000056, KEY_NONE, 0}, // Qt::Key_Hyper_L
    {0x01000057, KEY_NONE, 0}, // Qt::Key_Hyper_R
    {0x01000058, KEY_HELP, 0}, // Qt::Key_Help
    {0x01000059, KEY_NONE, 0}, // Qt::Key_Direction_L
    {0x01000060, KEY_NONE, 0}, // Qt::Key_Direction_R

    // ----------------------------
    // Additional Special Keys
    // ----------------------------
    {0x0a0, KEY_NONE, 0}, // Qt::Key_nobreakspace
    {0x0a1, KEY_NONE, 0}, // Qt::Key_exclamdown
    {0x0a2, KEY_NONE, 0}, // Qt::Key_cent
    {0x0a3, KEY_NONE, 0}, // Qt::Key_sterling
    {0x0a4, KEY_NONE, 0}, // Qt::Key_currency
    {0x0a5, KEY_YEN, 0}, // Qt::Key_yen
    {0x0a6, KEY_NONE, 0}, // Qt::Key_brokenbar
    {0x0a7, KEY_NONE, 0}, // Qt::Key_section
    {0x0a8, KEY_NONE, 0}, // Qt::Key_diaeresis
    {0x0a9, KEY_NONE, 0}, // Qt::Key_copyright
    {0x0aa, KEY_NONE, 0}, // Qt::Key_ordfeminine
    {0x0ab, KEY_NONE, 0}, // Qt::Key_guillemotleft
    {0x0ac, KEY_NONE, 0}, // Qt::Key_notsign
    {0x0ad, KEY_NONE, 0}, // Qt::Key_hyphen
    {0x0ae, KEY_NONE, 0}, // Qt::Key_registered
    {0x0af, KEY_NONE, 0}, // Qt::Key_macron
    {0x0b0, KEY_NONE, 0}, // Qt::Key_degree
    {0x0b1, KEY_NONE, 0}, // Qt::Key_plusminus
    {0x0b2, KEY_NONE, 0}, // Qt::Key_twosuperior
    {0x0b3, KEY_NONE, 0}, // Qt::Key_threesuperior
    {0x0b4, KEY_NONE, 0}, // Qt::Key_acute
    {0x0b5, KEY_NONE, 0}, // Qt::Key_micro
    {0x0b6, KEY_NONE, 0}, // Qt::Key_paragraph
    {0x0b7, KEY_NONE, 0}, // Qt::Key_periodcentered
    {0x0b8, KEY_NONE, 0}, // Qt::Key_cedilla
    {0x0b9, KEY_NONE, 0}, // Qt::Key_onesuperior
    {0x0ba, KEY_NONE, 0}, // Qt::Key_masculine
    {0x0bb, KEY_NONE, 0}, // Qt::Key_guillemotright
    {0x0bc, KEY_NONE, 0}, // Qt::Key_onequarter
    {0x0bd, KEY_NONE, 0}, // Qt::Key_onehalf
    {0x0be, KEY_NONE, 0}, // Qt::Key_threequarters
    {0x0bf, KEY_NONE, 0}, // Qt::Key_questiondown

    {0x0c0, KEY_NONE, 0}, // Qt::Key_Agrave
    {0x0c1, KEY_NONE, 0}, // Qt::Key_Aacute
    {0x0c2, KEY_NONE, 0}, // Qt::Key_Acircumflex
    {0x0c3, KEY_NONE, 0}, // Qt::Key_Atilde
    {0x0c4, KEY_NONE, 0}, // Qt::Key_Adiaeresis
    {0x0c5, KEY_NONE, 0}, // Qt::Key_Aring
    {0x0c6, KEY_NONE, 0}, // Qt::Key_AE
    {0x0c7, KEY_NONE, 0}, // Qt::Key_Ccedilla
    {0x0c8, KEY_NONE, 0}, // Qt::Key_Egrave
    {0x0c9, KEY_NONE, 0}, // Qt::Key_Eacute
    {0x0ca, KEY_NONE, 0}, // Qt::Key_Ecircumflex
    {0x0cb, KEY_NONE, 0}, // Qt::Key_Ediaeresis
    {0x0cc, KEY_NONE, 0}, // Qt::Key_Igrave
    {0x0cd, KEY_NONE, 0}, // Qt::Key_Iacute
    {0x0ce, KEY_NONE, 0}, // Qt::Key_Icircumflex
    {0x0cf, KEY_NONE, 0}, // Qt::Key_Idiaeresis
    {0x0d0, KEY_NONE, 0}, // Qt::Key_ETH
    {0x0d1, KEY_NONE, 0}, // Qt::Key_Ntilde
    {0x0d2, KEY_NONE, 0}, // Qt::Key_Ograve
    {0x0d3, KEY_NONE, 0}, // Qt::Key_Oacute
    {0x0d4, KEY_NONE, 0}, // Qt::Key_Ocircumflex
    {0x0d5, KEY_NONE, 0}, // Qt::Key_Otilde
    {0x0d6, KEY_O, 0}, // Qt::Key_Odiaeresis 'Ö' mapped to 'O'
    {0x0d7, KEY_KPMINUS, 0}, // Qt::Key_multiply '×' mapped to Keypad Minus
    // {0x0d8, KEY_OOBLIQUE, 0}, // Qt::Key_Ooblique 'Ø'
    {0x0d9, KEY_U, 0}, // Qt::Key_Ugrave 'Ù' mapped to 'U'
    {0x0da, KEY_U, 0}, // Qt::Key_Uacute 'Ú' mapped to 'U'
    {0x0db, KEY_U, 0}, // Qt::Key_Ucircumflex 'Û' mapped to 'U'
    {0x0dc, KEY_U, 0}, // Qt::Key_Udiaeresis 'Ü' mapped to 'U'
    {0x0dd, KEY_Y, 0}, // Qt::Key_Yacute 'Ý' mapped to 'Y'
    {0x0de, KEY_NONE, 0}, // Qt::Key_THORN 'Þ'
    {0x0df, KEY_NONE, 0}, // Qt::Key_ssharp 'ß'
    // {0x0f7, KEY_DIVISION, 0}, // Qt::Key_division '÷'
    {0x0ff, KEY_NONE, 0}, // Qt::Key_ydiaeresis 'ÿ'

    // ----------------------------
    // Media and Additional Keys (Optional)
    // ----------------------------
    // Depending on your application's needs, you can map additional media keys here.
    // Example:
    // {0x... , KEY_MEDIA_PLAYPAUSE, 0}, // Qt::Key_Media_PlayPause
    // {0x... , KEY_MEDIA_VOLUMEUP, 0}, // Qt::Key_Media_VolumeUp
    // Add more as needed.

    // ----------------------------
    // Unmapped or Unsupported Keys
    // ----------------------------
    // Keys that do not have a direct HID equivalent are mapped to KEY_NONE.
    // You can handle these cases as needed in your application logic.
    
    // Example:
    // {0x01000053, KEY_NONE, 0}, // Qt::Key_Super_L (already mapped as KEY_FRONT)
    // {0x01000054, KEY_NONE, 0}, // Qt::Key_Super_R (already mapped as KEY_FRONT)
    // etc.
};

#define QT_HID_MAP_SIZE (sizeof(qt_hid_map) / sizeof(qt_to_hid_mapping_t))


static K_SEM_DEFINE(usb_sem, 1, 1);	/* starts off "available" */
static void in_ready_cb(const struct device *dev)
{
	ARG_UNUSED(dev);
    printk("in_ready_cb\n");
	k_sem_give(&usb_sem);
}

// Function to get HID key code and modifier from Qt key code
bool get_hid_key(uint32_t qt_key, uint8_t *hid_key, uint8_t *modifier) {
    for (size_t i = 0; i < QT_HID_MAP_SIZE; i++) {
        if (qt_hid_map[i].qt_key == qt_key) {
            *hid_key = qt_hid_map[i].hid_key;
            *modifier = qt_hid_map[i].modifier;
            return true;
        }
    }
    return false; // Key not found
}

const struct device *hid0_dev;
const struct device *hid1_dev;

static const uint8_t hid_kbd_report_desc[] = HID_KEYBOARD_REPORT_DESC();

static const struct hid_ops ops = {
	.int_in_ready = in_ready_cb,
};

bool hid_keyboard_init(void)
{
    
	hid0_dev = device_get_binding("HID_0");
	if (hid0_dev == NULL) {
		printk("Cannot get USB HID 0 Device");
		return 0;
	}
	/* Initialize HID */
	usb_hid_register_device(hid0_dev, hid_kbd_report_desc,
				sizeof(hid_kbd_report_desc), &ops);
	if(usb_hid_init(hid0_dev))
    {
        printk("Failed to initialize HID device\n");
        return false;
    }

    hid1_dev = device_get_binding("HID_1");
    if (hid1_dev == NULL) {
        printk("Cannot get USB HID 1 Device");
        return 0;
    }
    usb_hid_register_device(hid1_dev, hid_mouse_abs_report_desc,
                sizeof(hid_mouse_abs_report_desc), &ops);
    if(usb_hid_init(hid1_dev))
    {
        printk("Failed to initialize HID device\n");
        return false;
    }

    return true;
}

bool hid_keyboard_send_report(uint8_t *report)
{
	k_sem_take(&usb_sem, K_MSEC(100));
    return hid_int_ep_write(hid0_dev, report, HID_REPORT_SIZE_K, NULL);
}

bool hid_mouse_abs_send(uint8_t buttons, uint16_t x, uint16_t y, int8_t wheel)
{
    uint8_t report[6];
    report[0] = buttons;        
    report[1] = (uint8_t)(x & 0xFF);
    report[2] = (uint8_t)(x >> 8);
    report[3] = (uint8_t)(y & 0xFF);
    report[4] = (uint8_t)(y >> 8);
    report[5] = (uint8_t)(wheel);
    k_sem_take(&usb_sem, K_MSEC(100));
    int err = hid_int_ep_write(hid1_dev, report, sizeof(report), NULL);
    return (err == 0);
}

bool hid_mouse_abs_clear(void)
{
    uint8_t report[6] = {0};
    k_sem_take(&usb_sem, K_MSEC(100));
    int err = hid_int_ep_write(hid1_dev, report, sizeof(report), NULL);
    return (err == 0);
}
```

## src/hid_km.h
```c
#ifndef HID_KEYBOARD_H
#define HID_KEYBOARD_H
#include <stdint.h>
#include <stdbool.h>
#include <stdio.h>

#define HID_REPORT_SIZE_L 8
#define HID_REPORT_SIZE_M 4


bool hid_keyboard_init(void);

bool hid_keyboard_send_report(uint8_t *report);
bool get_hid_key(uint32_t qt_key, uint8_t *hid_key, uint8_t *modifier);

bool hid_mouse_abs_send(uint8_t buttons, uint16_t x, uint16_t y, int8_t wheel);
bool hid_mouse_abs_clear(void);

#endif // HID_KEYBOARD_H
```
